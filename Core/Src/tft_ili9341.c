#include "tft_ili9341.h"
#include "main.h"
#include "spi.h"
#include <string.h>

#define TFT_CS_LOW()   HAL_GPIO_WritePin(TFT_CS_GPIO_Port,  TFT_CS_Pin,  GPIO_PIN_RESET)
#define TFT_CS_HIGH()  HAL_GPIO_WritePin(TFT_CS_GPIO_Port,  TFT_CS_Pin,  GPIO_PIN_SET)
#define TFT_DC_CMD()   HAL_GPIO_WritePin(TFT_DC_GPIO_Port,  TFT_DC_Pin,  GPIO_PIN_RESET)
#define TFT_DC_DATA()  HAL_GPIO_WritePin(TFT_DC_GPIO_Port,  TFT_DC_Pin,  GPIO_PIN_SET)
#define TFT_RST_LOW()  HAL_GPIO_WritePin(TFT_RST_GPIO_Port, TFT_RST_Pin, GPIO_PIN_RESET)
#define TFT_RST_HIGH() HAL_GPIO_WritePin(TFT_RST_GPIO_Port, TFT_RST_Pin, GPIO_PIN_SET)

static const uint8_t font5x8[95][5] = {
    {0x00,0x00,0x00,0x00,0x00},
    {0x00,0x00,0x5F,0x00,0x00},
    {0x00,0x07,0x00,0x07,0x00},
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    {0x10,0x08,0x08,0x10,0x08},
};

static uint8_t pixBuf[128];
static uint8_t charBuf[96];

static void SendCmdData(uint8_t cmd, const uint8_t *data, uint16_t len) {
    TFT_CS_LOW();
    TFT_DC_CMD();
    HAL_SPI_Transmit(&hspi1, &cmd, 1, HAL_MAX_DELAY);
    if (len > 0 && data != NULL) {
        TFT_DC_DATA();
        HAL_SPI_Transmit(&hspi1, (uint8_t *)data, len, HAL_MAX_DELAY);
    }
    TFT_CS_HIGH();
}

static void SetWindow(uint16_t x0, uint16_t y0, uint16_t x1, uint16_t y1) {
    uint8_t d[4];
    d[0] = x0 >> 8; d[1] = x0 & 0xFF; d[2] = x1 >> 8; d[3] = x1 & 0xFF;
    SendCmdData(0x2A, d, 4);
    d[0] = y0 >> 8; d[1] = y0 & 0xFF; d[2] = y1 >> 8; d[3] = y1 & 0xFF;
    SendCmdData(0x2B, d, 4);
    uint8_t cmd = 0x2C;
    TFT_CS_LOW();
    TFT_DC_CMD();
    HAL_SPI_Transmit(&hspi1, &cmd, 1, HAL_MAX_DELAY);
    TFT_DC_DATA();
}

void TFT_Init(void) {
    TFT_CS_HIGH();
    HAL_GPIO_WritePin(TOUCH_CS_GPIO_Port, TOUCH_CS_Pin, GPIO_PIN_SET);
    TFT_DC_DATA();

    TFT_RST_HIGH();
    TFT_RST_LOW();  HAL_Delay(20);
    TFT_RST_HIGH(); HAL_Delay(120);

    SendCmdData(0x01, NULL, 0); HAL_Delay(120);
    SendCmdData(0x28, NULL, 0);

    { static const uint8_t d[] = {0x00,0xC1,0x30};           SendCmdData(0xCF,d,3); }
    { static const uint8_t d[] = {0x64,0x03,0x12,0x81};      SendCmdData(0xED,d,4); }
    { static const uint8_t d[] = {0x85,0x00,0x78};           SendCmdData(0xE8,d,3); }
    { static const uint8_t d[] = {0x39,0x2C,0x00,0x34,0x02}; SendCmdData(0xCB,d,5); }
    { static const uint8_t d[] = {0x20};                     SendCmdData(0xF7,d,1); }
    { static const uint8_t d[] = {0x00,0x00};                SendCmdData(0xEA,d,2); }

    { static const uint8_t d[] = {0x23};      SendCmdData(0xC0,d,1); }
    { static const uint8_t d[] = {0x10};      SendCmdData(0xC1,d,1); }
    { static const uint8_t d[] = {0x3E,0x28}; SendCmdData(0xC5,d,2); }
    { static const uint8_t d[] = {0x86};      SendCmdData(0xC7,d,1); }

    { static const uint8_t d[] = {0x55}; SendCmdData(0x3A,d,1); }
    { static const uint8_t d[] = {0x00,0x18}; SendCmdData(0xB1,d,2); }
    { static const uint8_t d[] = {0x08,0x82,0x27}; SendCmdData(0xB6,d,3); }

    { static const uint8_t d[] = {0x00}; SendCmdData(0xF2,d,1); }
    { static const uint8_t d[] = {0x01}; SendCmdData(0x26,d,1); }

    { static const uint8_t d[] = {0x0F,0x31,0x2B,0x0C,0x0E,0x08,0x4E,0xF1,
                                   0x37,0x07,0x10,0x03,0x0E,0x09,0x00};
      SendCmdData(0xE0,d,15); }
    { static const uint8_t d[] = {0x00,0x0E,0x14,0x03,0x11,0x07,0x31,0xC1,
                                   0x48,0x08,0x0F,0x0C,0x31,0x36,0x0F};
      SendCmdData(0xE1,d,15); }

    { static const uint8_t d[] = {0x48}; SendCmdData(0x36,d,1); }

    SendCmdData(0x11, NULL, 0); HAL_Delay(120);
    SendCmdData(0x29, NULL, 0); HAL_Delay(20);

    TFT_FillScreen(TFT_BLACK);
}

void TFT_FillRect(int16_t x, int16_t y, int16_t w, int16_t h, uint16_t color) {
    if (w <= 0 || h <= 0) return;
    uint32_t total = (uint32_t)w * (uint32_t)h;
    uint8_t hi = color >> 8;
    uint8_t lo = color & 0xFF;
    uint16_t i;

    for (i = 0; i < sizeof(pixBuf); i += 2) { pixBuf[i] = hi; pixBuf[i+1] = lo; }

    SetWindow((uint16_t)x, (uint16_t)y,
              (uint16_t)(x + w - 1), (uint16_t)(y + h - 1));

    while (total >= sizeof(pixBuf) / 2) {
        HAL_SPI_Transmit(&hspi1, pixBuf, sizeof(pixBuf), HAL_MAX_DELAY);
        total -= sizeof(pixBuf) / 2;
    }
    if (total > 0) {
        HAL_SPI_Transmit(&hspi1, pixBuf, (uint16_t)(total * 2u), HAL_MAX_DELAY);
    }
    TFT_CS_HIGH();
}

void TFT_FillScreen(uint16_t color) {
    TFT_FillRect(0, 0, TFT_W, TFT_H, color);
}

void TFT_DrawRect(int16_t x, int16_t y, int16_t w, int16_t h, uint16_t color) {
    TFT_FillRect(x,     y,     w, 1, color);
    TFT_FillRect(x,     y+h-1, w, 1, color);
    TFT_FillRect(x,     y,     1, h, color);
    TFT_FillRect(x+w-1, y,     1, h, color);
}

void TFT_DrawChar(int16_t x, int16_t y, char c, uint16_t fg, uint16_t bg, uint8_t sz) {
    const uint8_t *glyph;
    int row, col, idx;

    if (c < 0x20 || c > 0x7E) c = '?';
    glyph = font5x8[(uint8_t)c - 0x20];

    if (sz == 1) {
        idx = 0;
        for (row = 0; row < 8; row++) {
            for (col = 0; col < 5; col++) {
                uint16_t color = (glyph[col] & (1u << row)) ? fg : bg;
                charBuf[idx++] = (uint8_t)(color >> 8);
                charBuf[idx++] = (uint8_t)(color & 0xFF);
            }
            charBuf[idx++] = (uint8_t)(bg >> 8);
            charBuf[idx++] = (uint8_t)(bg & 0xFF);
        }
        SetWindow((uint16_t)x, (uint16_t)y,
                  (uint16_t)(x + 5), (uint16_t)(y + 7));
        HAL_SPI_Transmit(&hspi1, charBuf, sizeof(charBuf), HAL_MAX_DELAY);
        TFT_CS_HIGH();
    } else {
        for (col = 0; col < 5; col++) {
            for (row = 0; row < 8; row++) {
                uint16_t color = (glyph[col] & (1u << row)) ? fg : bg;
                TFT_FillRect((int16_t)(x + col * sz), (int16_t)(y + row * sz),
                             sz, sz, color);
            }
        }
        TFT_FillRect((int16_t)(x + 5 * sz), y, sz, (int16_t)(8 * sz), bg);
    }
}

void TFT_DrawString(int16_t x, int16_t y, const char *s,
                    uint16_t fg, uint16_t bg, uint8_t sz) {
    while (*s) {
        TFT_DrawChar(x, y, *s++, fg, bg, sz);
        x += (int16_t)(6 * sz);
    }
}
